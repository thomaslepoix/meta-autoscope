## conf/distro/autoscope.conf
```bitbake
require conf/distro/poky.conf

DISTRO = "autoscope"
DISTRO_NAME = "Autoscope powered by Yocto/OE"
DISTROOVERRIDES = "poky:autoscope"

#	ipv6
DISTRO_FEATURES_remove = " \
	opengl \
	wayland \
	x11 \
	bluetooth \
	3g \
	nfc \
	nfs \
	ext2 \
	pulseaudio \
	zeroconf \
"
```

## conf/local.conf.sample
```bitbake
MACHINE ?= "raspberrypi3"
DISTRO ?= "autoscope"

BB_DISKMON_DIRS = "\
    STOPTASKS,${TMPDIR},1G,100K \
    STOPTASKS,${DL_DIR},1G,100K \
    STOPTASKS,${SSTATE_DIR},1G,100K \
    STOPTASKS,/tmp,100M,100K \
    ABORT,${TMPDIR},100M,1K \
    ABORT,${DL_DIR},100M,1K \
    ABORT,${SSTATE_DIR},100M,1K \
    ABORT,/tmp,10M,1K"

CONF_VERSION = "1"

BB_NUMBER_THREADS ?= "8"
PARALLEL_MAKE ?= "-j 4"
PATCHRESOLVE = "noop"

#LICENSE_FLAGS_WHITELIST = "commercial"
#IMAGE_INSTALL_append = "omxplayer"

#raspberry pi config
BOOT_DELAY = "0"
RPI_USE_U_BOOT = "1"
VIDEO_CAMERA = "1"
GPU_MEM = "128"
```

## scripts/conf/bblayers.conf
```bitbake
LCONF_VERSION = "6"

BBPATH = "${TOPDIR}"
BSPDIR := "${@os.path.abspath(os.path.dirname(d.getVar('FILE', True)) + '/../..')}"

BBFILES ?= ""
BBLAYERS = " \
  ${BSPDIR}/sources/poky/meta \
  ${BSPDIR}/sources/poky/meta-poky \
"

BBLAYERS += " \
  ${BSPDIR}/sources/meta-freescale \
  ${BSPDIR}/sources/meta-freescale-3rdparty \
  ${BSPDIR}/sources/meta-freescale-distro \
  ${BSPDIR}/sources/meta-picopi-imx7d \
  ${BSPDIR}/sources/meta-autoscope \
  \
  ${BSPDIR}/sources/meta-openembedded/meta-oe \
  ${BSPDIR}/sources/meta-openembedded/meta-multimedia \
  ${BSPDIR}/sources/meta-openembedded/meta-python \
  ${BSPDIR}/sources/meta-openembedded/meta-networking \
"
```
